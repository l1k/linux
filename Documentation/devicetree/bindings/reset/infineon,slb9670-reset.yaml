## Documentation/devicetree/bindings/reset/infineon,slb9670-reset.yaml
```yaml
# SPDX-License-Identifier: (GPL-2.0-only OR BSD-2-Clause)
%YAML 1.2
---
$id: http://devicetree.org/schemas/reset/infineon,slb9670-reset.yaml#
$schema: http://devicetree.org/meta-schemas/core.yaml#

title: Infineon SLB9670 TPM Reset

maintainers:
  - Lukas Wunner <lukas@wunner.de>

description: |
  The Infineon SLB9670 Trusted Platform Module requires a specific reset
  sequence on its RST# pin which is documented in sections 5.4 and 5.5 of
  the datasheet [1]:

  deassert RST#
  wait at least 60 ms
  assert RST#
  wait at least 2 usecs
  deassert RST#
  wait at least 60 ms
  assert RST#
  wait at least 2 usecs
  deassert RST#
  wait at least 60 ms before issuing the first TPM command

  [1] https://www.infineon.com/dgdl/?fileId=5546d4626fc1ce0b016fc78270350cd6

properties:
  compatible:
    enum:
      - infineon,slb9670-reset

  reset-gpios:
    maxItems: 1
    description: GPIO connected to the RST# pin

  "#reset-cells":
    const: 0

required:
  - compatible
  - reset-gpios
  - "#reset-cells"

additionalProperties: false

examples:
  - |
    #include <dt-bindings/gpio/gpio.h>
    reset-controller {
        compatible = "infineon,slb9670-reset";
        #reset-cells = <0>;
        reset-gpios = <&gpio 0 GPIO_ACTIVE_LOW>;
    };
```

## Documentation/devicetree/bindings/security/tpm/tpm_tis_spi.txt
```
Required properties:
- compatible: should be one of the following
    "st,st33htpm-spi"
    "infineon,slb9670"
    "tcg,tpm_tis-spi"
- spi-max-frequency: Maximum SPI frequency (depends on TPMs).

Optional SoC Specific Properties:
- pinctrl-names: Contains only one value - "default".
- pintctrl-0: Specifies the pin control groups used for this controller.
- reset-gpios: Specifies the reset GPIO.

Example (for ARM-based BeagleBoard xM with TPM_TIS on SPI4):

&mcspi4 {


        tpm_tis@0 {

                compatible = "tcg,tpm_tis-spi";

                spi-max-frequency = <10000000>;
		reset-gpios = <&gpio 3 GPIO_ACTIVE_LOW>;
        };
};
```

## Documentation/devicetree/bindings/serial/rs485.yaml
```yaml
# SPDX-License-Identifier: GPL-2.0
%YAML 1.2
---
$id: http://devicetree.org/schemas/serial/rs485.yaml#
$schema: http://devicetree.org/meta-schemas/core.yaml#

title: RS485 serial communications Bindings

description: The RTS signal is capable of automatically controlling line
  direction for the built-in half-duplex mode. The properties described
  hereafter shall be given to a half-duplex capable UART node.

maintainers:
  - Rob Herring <robh@kernel.org>

properties:
  rs485-rts-delay:
    description: prop-encoded-array <a b>
    $ref: /schemas/types.yaml#/definitions/uint32-array
    items:
      items:
        - description: "Driver Enable to Output Delay" in nanoseconds as given
            in the transceiver datasheet. Specifies the delay between enabling
            the driver (assertion of RTS) and transmission of the start bit.
            For most transceivers it's so short that it can safely be omitted.
          default: 0
          maximum: 20000
        - description: "Driver Propagation Delay" in nanoseconds as given in
            the transceiver datasheet. Specifies the delay between transmission
            of the stop bit and disabling the driver (deassertion of RTS).
            The delay allows the stop bit to transition through the transceiver
            before its driver is disabled.
          default: 0
          maximum: 20000

  rs485-rts-active-low:
    description: drive RTS low when sending (default is high).
    $ref: /schemas/types.yaml#/definitions/flag

  linux,rs485-enabled-at-boot-time:
    description: enables the rs485 feature at boot time. It can be disabled
      later with proper ioctl.
    $ref: /schemas/types.yaml#/definitions/flag

  rs485-rx-during-tx:
    description: enables the receiving of data even while sending data.
    $ref: /schemas/types.yaml#/definitions/flag

  rs485-term-gpios:
    description: GPIO pin to enable RS485 bus termination.
    maxItems: 1

additionalProperties: true

...
```
